## config/boards/shields/nice_view_bongo/Kconfig.defconfig
```kconfig
if SHIELD_NICE_VIEW_BONGO

config LS0XX_VCOM_THREAD_PRIO
    default 11

config LV_Z_VDB_SIZE
    default 100

config LV_DPI_DEF
    default 161

config LV_Z_BITS_PER_PIXEL
    default 1

choice LV_COLOR_DEPTH
    default LV_COLOR_DEPTH_1
endchoice

choice ZMK_DISPLAY_WORK_QUEUE
    default ZMK_DISPLAY_WORK_QUEUE_DEDICATED
endchoice

choice ZMK_DISPLAY_STATUS_SCREEN
    default ZMK_DISPLAY_STATUS_SCREEN_CUSTOM
endchoice

config LV_Z_MEM_POOL_SIZE
    default 8192

config ZMK_DISPLAY_STATUS_SCREEN_CUSTOM
    select NICE_VIEW_BONGO_WIDGET

config NICE_VIEW_BONGO_WIDGET
    bool "Bongo Cat status widget for nice!view"
    select LV_FONT_UNSCII_8
    select LV_USE_CANVAS
    select ZMK_WPM

endif # SHIELD_NICE_VIEW_BONGO
```

## config/boards/shields/nice_view_bongo/Kconfig.shield
```kconfig
config SHIELD_NICE_VIEW_BONGO
    def_bool $(shields_list_contains,nice_view_bongo)
```

## config/boards/shields/right_status/Kconfig.defconfig
```kconfig
if SHIELD_NICE_VIEW_FUNKEEB

config LS0XX_VCOM_THREAD_PRIO
    default 11

config LV_Z_VDB_SIZE
    default 100

config LV_DPI_DEF
    default 161

config LV_Z_BITS_PER_PIXEL
    default 1

choice LV_COLOR_DEPTH
    default LV_COLOR_DEPTH_1
endchoice

choice ZMK_DISPLAY_WORK_QUEUE
    default ZMK_DISPLAY_WORK_QUEUE_DEDICATED
endchoice

choice ZMK_DISPLAY_STATUS_SCREEN
    default ZMK_DISPLAY_STATUS_SCREEN_CUSTOM
endchoice

config LV_Z_MEM_POOL_SIZE
    default 8192

config ZMK_DISPLAY_STATUS_SCREEN_CUSTOM
    select NICE_VIEW_FUNKEEB_WIDGET

config NICE_VIEW_FUNKEEB_WIDGET
    bool "FunkeeB peripheral status widget for nice!view"
    select LV_FONT_MONTSERRAT_18
    select LV_USE_CANVAS

endif # SHIELD_NICE_VIEW_FUNKEEB
```

## config/boards/shields/right_status/Kconfig.shield
```kconfig
config SHIELD_NICE_VIEW_FUNKEEB
    def_bool $(shields_list_contains,nice_view_funkeeb)
```

## config/west.yml
```yaml
manifest:
  remotes:
    - name: zmkfirmware
      url-base: https://github.com/zmkfirmware
    - name: petejohanson
      url-base: https://github.com/petejohanson
    - name: gpeye
      url-base: https://github.com/GPeye
    - name: mctechnology17
      url-base: https://github.com/mctechnology17
    - name: kevinpastor
      url-base: https://github.com/kevinpastor
    - name: m165437
      url-base: https://github.com/M165437
    - name: s6t
      url-base: https://github.com/s6t
    - name: infely
      url-base: https://github.com/infely
    - name: AYM1607
      url-base: https://github.com/AYM1607
    - name: finestedm
      url-base: https://github.com/finestedm
  projects:
    - name: zmk
      remote: zmkfirmware
      revision: 6e2ef41e022d555b10f116e395832913f71717b3
      import: app/west.yml
    - name: hammerbeam-slideshow
      remote: gpeye
      revision: main
    - name: zmk-nice-oled
      remote: mctechnology17
      revision: main
    - name: nice-view-elemental
      remote: kevinpastor
      revision: main
    - name: nice-view-gem
      remote: m165437
      revision: main
    - name: zmk-shield-nice-view-cats
      remote: s6t
      revision: main
    - name: nice-view-battery
      remote: infely
      revision: main
    - name: zmk-driver-azoteq-iqs5xx
      remote: finestedm
      revision: bbeaf0a5301ab58e7a30e67caa409fa26cf841cd
    - name: zmk-widget-bridge
      remote: finestedm
      revision: 75874ddc62bfa50ddde5926ae231966352d6df06
  self:
    path: config
```
